## drivers/input/touchscreen/mediatek/Kconfig
```kconfig
#
# Touchscreen driver configuration
#
menuconfig INPUT_TOUCHSCREEN
	bool "Touchscreens"
	help
	  Say Y here, and a list of supported touchscreens will be displayed.
	  This option doesn't affect the kernel.

	  If unsure, say Y.

if INPUT_TOUCHSCREEN

config TOUCHSCREEN_MTK
	bool "MediaTek Touch Panel Driver"
	help
	  Say Y here if you have MediaTek touch panel.

	  If unsure, say N.

	  To compile this dirver as a module, choose M here: the
	  module will be called.

config TOUCHSCREEN_MTK_GT1151
	bool "GT1151 for Mediatek package"
	default n
	help
	  Say Y here if you have GT1151 touch panel.

	  If unsure, say N.

	  To compile this dirver as a module, choose M here: the
	  module will be called.

source "drivers/input/touchscreen/mediatek/GT1151/Kconfig"

config TOUCHSCREEN_MTK_GT928
	tristate "GT928 Touchscreen"
	help
	  Say Y here if you have Goodix GT928 touchscreen,
	  connected to your system.
	  If unsure, say N.
	  To compile this driver as a module, choose M here.
config TOUCHSCREEN_MTK_GT9XXTB_HOTKNOT
	bool "GT9XXTB hotknot for Mediatek package"
	default n
	help
	  Say Y here if you have GT9xx touch panel.

	  If unsure, say N.

	  To compile this dirver as a module, choose M here: the
	  module will be called.

source "drivers/input/touchscreen/mediatek/GT9XXTB_hotknot/Kconfig"

config TOUCHSCREEN_MTK_SYNAPTICS_I2C_RMI4
	tristate "Synaptics DSX I2C touchscreen"
	depends on I2C
	help
	  Say Y here if you have a Synaptics DSX I2C touchscreen
	  connected to your system.

	  If unsure, say N.

	  To compile this driver as a module, choose M here: the
	  module will be called synaptics_i2c_rmi4.

source "drivers/input/touchscreen/mediatek/synaptics_i2c_rmi4/Kconfig"

config TOUCHSCREEN_MTK_GT910
	bool "GT910 for Mediatek package"
	default n
	help
	  Say Y here if you have GT910 touch panel.

	  If unsure, say N.

	  To compile this dirver as a module, choose M here: the
	  module will be called.

source "drivers/input/touchscreen/mediatek/GT910/Kconfig"

config TOUCHSCREEN_MTK_GT9XX_HOTKNOT_SCP
	bool "GT9XX_HOTKNOT_SCP for Mediatek package"
	default n
	help
	  Say Y here if you have GT9XX_HOTKNOT_SCP touch panel.

	  If unsure, say N.

	  To compile this dirver as a module, choose M here: the
	  module will be called.

source "drivers/input/touchscreen/mediatek/GT9XX_hotknot_scp/Kconfig"

config TOUCHSCREEN_MTK_GT911
	bool "GT911 for Mediatek package"
	default n
	help
	  Say Y here if you have GT911 touch panel.

	  If unsure, say N.

	  To compile this dirver as a module, choose M here: the
	  module will be called.

source "drivers/input/touchscreen/mediatek/GT911/Kconfig"

config TOUCHSCREEN_MTK_FT5X0X
	bool "FT5X0X for Mediatek package"
	default n
	help
	  Say Y here if you have FT5X0X touch panel.

	  If unsure, say N.

	  To compile this dirver as a module, choose M here: the
	  module will be called.

source "drivers/input/touchscreen/mediatek/ft5x0x/Kconfig"


config WTK_MSG2238_X2605
	bool "MSG2238 for Mediatek package"
	default n
	help
	  Say Y here if you have MSG2238 touch panel.

	  If unsure, say N.

	  To compile this dirver as a module, choose M here: the
	  module will be called.
	  
config WTK_MSG2238_X2605_s4
	bool "MSG2238 for Mediatek package"
	default n
	help
	  Say Y here if you have MSG2238 touch panel.

	  If unsure, say N.

	  To compile this dirver as a module, choose M here: the
	  module will be called.

config WTK_MSG2238_X5623
	bool "MSG2238 for Mediatek package"
	default n
	help
	  Say Y here if you have MSG2238 touch panel.

	  If unsure, say N.

	  To compile this dirver as a module, choose M here: the
	  module will be called.
	  
config WTK_MSG2238_X5057
	bool "MSG2238 for Mediatek package"
	default n
	help
	  Say Y here if you have MSG2238 touch panel.

	  If unsure, say N.

	  To compile this dirver as a module, choose M here: the
	  module will be called.	  
	  
config WTK_FT6336_S3619  
	bool "FT6336 for Mediatek package"
	default n
	help
	  Say Y here if you have FT5X0X touch panel.

	  If unsure, say N.

	  To compile this dirver as a module, choose M here: the
	  module will be called.
config WTK_GT9XX_HOTKNOT_X5613
	bool "gt9xx hotknot for Mediatek package"
	default n
	
config WTK_GT9XX_HOTKNOT_X5618
	bool "gt9xx hotknot for Mediatek package"
	default n
	
config WTK_GT9XX_HOTKNOT_M6010
	bool "gt9xx hotknot for Mediatek package"
	default n

config WTK_GT9XX_HOTKNOT_X5602
	bool "gt9xx hotknot for Mediatek package"
	default n
		
config WTK_FT6336_X2605  
	bool "FT6336 for Mediatek package"
	default n  
	
config WTK_GT5668_X5623
	bool "GT5668 for Mediatek package"
	default n
	
config WTK_GT9XX_HOTKNOT_X5057
	bool "gt9xx hotknot for Mediatek package"
	default n	

config WTK_GT9XX_HOTKNOT_X6069
	bool "gt9xx hotknot for Mediatek package"
	default n	

config WTK_GT5668_X6068
	bool "GT5668 for Mediatek package"
	default n	

config WTK_GT5668_X6069
	bool "GT5668 for Mediatek package"
	default n

config WTK_GSL1691_X5623
bool "GSL1691 for Mediatek package"
	default n
	
endif
```

## drivers/misc/mediatek/alsps/epl259x/Kconfig
```kconfig
config WTK_EPL259X
	bool "epl259x for MediaTek package"
	default n
	help
	It support different type sensor
	in this platform. If this option
	is set, it will support ambient
	and light sensor EPL259X.
```

## drivers/misc/mediatek/fingerprint/Kconfig
```kconfig
config WTK_FINGERPRINT
  bool WTK_FINGERPRINT
  default n
  help
    WTK_FINGERPRINT

config WTK_FINGERPRINT_SLSPI
  bool WTK_FINGERPRINT_SLSPI
  default n
  help
    WTK_FINGERPRINT_SLSPI
	
config WTK_FINGERPRINT_GF510
  bool WTK_FINGERPRINT_GF510
  default n
  help
    WTK_FINGERPRINT_GF510

config WTK_FINGERPRINT_GF66XX
  bool WTK_FINGERPRINT_GF66XX
  default n
  help
    WTK_FINGERPRINT_GF66XX
    
config WTK_FINGERPRINT_GFX1XM
  bool WTK_FINGERPRINT_GFX1XM
  default n
  help
    WTK_FINGERPRINT_GFX1XM

config WTK_FINGERPRINT_GFX368
  bool WTK_FINGERPRINT_GFX368
  default n
  help
    WTK_FINGERPRINT_GFX368

config WTK_FINGERPRINT_A121N
  bool WTK_FINGERPRINT_A121N
  default n
  help
    WTK_FINGERPRINT_A121N    
    
config WTK_FINGERPRINT_EFSA96S
  bool WTK_FINGERPRINT_EFSA96S
  default n
  help
    WTK_FINGERPRINT_EFSA96S
```

## drivers/misc/mediatek/leds/Kconfig
```kconfig
config MTK_LEDS
	tristate "MediaTek LED Support"
	depends on LEDS_CLASS
	---help---
	  This selects the MediaTek(R) LEDs connected to MediaTek chips.
	  If you want to use MediaTek(R) LEDs support, say Y or M here.
	  If unsure, say N.
	  Mediatek LED module includes backlight, indicate LED, keypad LED, button LED etc.

config LIGHTNESS_MAPPING_VALUE
	int "LIGHTNESS_MAPPING_VALUE"
	default 255
 	---help---
	  Backlight brightness mapping value, from 0 to 255.

config TB8173_EVB
	bool "Support TB8173 EVB board"
	
config WTK_LEDS_AW2015
	bool "Support AW2015"
	
config WTK_LEDS_AW2013
	bool "Support AW2013"	
	
config ISINK_BREATH_MODE
	bool "ISINK_BREATH_MODE"	
```

## drivers/misc/mediatek/mhall/Kconfig
```kconfig
config WTK_MHALL
	bool "WTK_MHALL"
	help
	  ALSPS sensor driver to detect ambient light and the object is close
	  or far awary from device. After configure this configuration,
          the specific ambient light and proximity sensor driver configuration
          should be configured as well.
```
